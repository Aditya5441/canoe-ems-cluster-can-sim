VERSION ""

NS_ :

BS_:

BU_: Cluster EMS

BO_ 257 Cluster_Display_Msg: 8 Cluster
 SG_ Warning_Over_Speed : 1|1@1+ (1,0) [0|1] "" Vector__XXX
 SG_ Warning_Lamp : 0|1@1+ (1,0) [0|1] "" Vector__XXX

BO_ 256 EMS_Data_Msg: 8 EMS
 SG_ Engine_Temperature : 16|8@1+ (1,0) [-40|250] ""  Cluster
 SG_ Engine_Speed : 0|16@1+ (1,0) [0|10000] ""  Cluster

BA_DEF_  "BusType" STRING ;
BA_DEF_DEF_  "BusType" "CAN";
